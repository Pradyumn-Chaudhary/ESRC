#define num_led_segments 17
#define num_characters 38

int picoPinGPIO[num_led_segments] = {2,3,4,5,6,7,8,9,10,11,12,13,14,15,16,17,18};

int fontSymbol[num_characters][num_led_segments] = {
// A2,A1, F, H, E, J, M, N, L,D2,D1,DP, C,G1, B,G2, K
  {1,1,1,0,1,0,0,1,0,1,1,0,1,0,1,0,1},//0
  {0,0,0,0,0,0,0,0,0,0,0,0,1,0,1,0,0},//1
  {1,1,0,0,1,0,0,0,0,1,1,0,0,1,1,1,0},//2
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  {1,1,0,0,0,1,1,0,0,1,1,0,0,1,0,1,0},//I

// A2,A1, F, H, E, J, M, N, L,D2,D1,DP, C,G1, B,G2, K
  {0,0,0,0,1,0,0,0,0,1,1,0,1,0,1,0,0},//J
  {0,0,1,0,1,0,0,0,1,0,0,0,0,1,0,0,1},//K
  {0,0,1,0,1,0,0,0,0,1,1,0,0,0,0,0,0},//L
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  {0, 0, 1, 0, 1, 1, 1, 0, 1, 0, 0, 1, 1, 1, 1, 1, 1}//#

};

int serialNum = 1;
char charToDisplay;

void setup() {
  // put your setup code here, to run once:
  for(int i = 0; i<num_led_segments; i++){
    pinMode(picoPinGPIO[i], OUTPUT);
  }
  Serial.begin(9600);

  while(!Serial);
}

void loop() {
  // put your main code here, to run repeatedly:
 
  Serial.print(serialNum);
  Serial.print(" What do you want to display? \r\n");
  Serial.print("Enter anything between 0-9 and A-Z \r\n");
 
  while(!Serial.available());

  charToDisplay = Serial.read();

  displayAlphabet(charToDisplay);
  delay(1000);
  serialNum++;
  while(Serial.available()){
    Serial.read();
  }

}


void displayAlphabet(char ch){
  int fontRowNum;
  if(ch >= '0' && ch <= '9'){
    fontRowNum = ch - '0';
  }
  else if(ch >= 'A' && ch <= 'Z'){
    fontRowNum = 10 + ch - 'A';
  }
  else if (ch == ' '){
    fontRowNum = 36;
  }
  else{
    fontRowNum = 37;
  }

  for(int i = 0; i<num_led_segments; i++){
    digitalWrite(picoPinGPIO[i], fontSymbol[fontRowNum][i]);
  }
}
